/* OLED SSD1306 显示驱动模块
 * =========================
 * 硬件: SSD1306 128x64 OLED, I2C1接口 (地址0x78), 100kHz
 * 帧缓冲: GARM[8][128] — 8页 x 128列, 每页8像素垂直排列, 每字节8像素(LSB在顶部)
 * 字体: OLED_F8x16 (ASCII 94字符 8x16), OLED_Numdata (数字0-9)
 * 坐标系: x=0~127 (列), y=0~7 (页地址 0xB0~0xB7)
 */
#include "stm32f4xx_hal.h"
#include "math.h"
#include "i2c.h"
#include "string.h"

uint8_t GARM[8][128];                   /* OLED帧缓冲区: 8页 x 128列, 每字节8像素 (垂直方向, LSB在上) */

/* ASCII 8x16字体表: 94个可打印字符 (空格' ' ~ '~'), 每字符占16字节
 * 前8字节=上半部分(页0), 后8字节=下半部分(页1)
 */
const uint8_t OLED_F8x16[][16]=
{
	0x00,0x00,0x00,0x00,0x00,0x00,0x00,0x00,
	0x00,0x00,0x00,0x00,0x00,0x00,0x00,0x00,//  0

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	0x00,0x00,0x00,0x00,0x00,0x00,0x00,0x00,//~ 94
};

/* 数字字体表: 0-9, 每数字16字节 (前8=上半部分, 后8=下半部分) */
const uint8_t OLED_Numdata[][16] =
{
  0x00,0xE0,0x10,0x08,0x08,0x10,0xE0,0x00,
	0x00,0x0F,0x10,0x20,0x20,0x10,0x0F,0x00,//0

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	0x00,0x00,0x31,0x22,0x22,0x11,0x0F,0x00,//9
};

/* ---- I2C底层通信 ---- */

/* OLED_Command — 发送单字节命令到SSD1306 (控制寄存器地址0x00)
 * 通过 I2C1 Mem_Write: 设备地址0x78, 寄存器0x00=命令模式
 */
void OLED_Command(uint8_t Command) {
    HAL_I2C_Mem_Write(&hi2c1,0X78, 0x00, I2C_MEMADD_SIZE_8BIT, &Command, 1, HAL_MAX_DELAY);
}

/* OLED_Data — 发送单字节数据到SSD1306 (显示数据寄存器地址0x40)
 * 通过 I2C1 Mem_Write: 设备地址0x78, 寄存器0x40=数据模式
 */
void OLED_Data(uint8_t Data) {
    HAL_I2C_Mem_Write(&hi2c1, 0X78, 0x40, I2C_MEMADD_SIZE_8BIT, &Data, 1, HAL_MAX_DELAY);
}

/* ---- 帧缓冲操作 ---- */

/* OLED_NewFrame — 清空帧缓冲区 (全黑) */
void OLED_NewFrame(void)
{
  memset(GARM,0,sizeof(GARM));
}

/* OLED_Setpixel — 在帧缓冲中设置单个像素点
 * x=0~127 (列), y=0~63 (行)
 * GARM按页组织: y/8得页索引, y%8得页内位偏移
 */
void OLED_Setpixel(uint8_t x,uint8_t y)
{
  if(x>=128||y>=64)return;
	GARM[y/8][x] |= 0X01<<(y%8);
}

/* OLED_SetImage — 整页填充图像数据 (简单重复, 通常用于测试) */
void OLED_SetImage(uint8_t *A)
{
	for(uint8_t i = 0;i<8;i++)
	{
		for(uint8_t k = 0;k<128;k++)
		{
      GARM[i][k] =  A[i];
		}
	}
}

/* OLED_ShowFrame — 将帧缓冲区GARM的全部内容刷新到OLED硬件
 * 刷新流程 (逐页):
 *   1. 设置页地址 (0xB0 + i, i=0~7)
 *   2. 设置列起始地址 (0x02=低4位, 0x10=高4位 → 从列0开始)
 *   3. I2C突发写入: [0x40(数据模式)] + [128字节页数据]
 */
void OLED_ShowFrame(void)
{
	uint8_t SendBuffer[129];
    SendBuffer[0] = 0X40;
	for(uint8_t i = 0;i<8;i++)
	{
		for(uint8_t j = 0;j<128;j++)
		{
	    SendBuffer[j+1] = GARM[i][j];
		}
		OLED_Command(0XB0+i);            /* 设置页地址 (0xB0~0xB7, 共8页) */
	    OLED_Command(0X02);              /* 设置列地址低4位 = 2 (起始列偏移) */
		OLED_Command(0X10);              /* 设置列地址高4位 = 0 → 实际列=0x00+2=2 */
		HAL_I2C_Master_Transmit(&hi2c1,0X78,SendBuffer,sizeof(SendBuffer),HAL_MAX_DELAY);
	}
}

/* OLED_Init — SSD1306 OLED初始化序列
 * ====================================
 * 完整的上电初始化流程 (参考SSD1306数据手册):
 *   0xAE: 关闭显示 (先关闭, 配置完成后再打开)
 *   0xD5+0x80: 设置显示时钟分频/振荡器频率 (默认值)
 *   0xA8+0x3F: 设置多路复用比 = 64 (对应64行)
 *   0xD3+0x00: 设置显示偏移 = 0
 *   0x40: 设置显示起始行 = 行0
 *   0xA1: 设置段重映射 (左右镜像, 列127→SEG0)
 *   0xC8: 设置COM扫描方向 (上下翻转, COM63→COM0)
 *   0xDA+0x12: 设置COM硬件引脚配置 (128x64模式)
 *   0x81+0xCF: 设置对比度 = 0xCF (最大亮度)
 *   0xD9+0xF1: 设置预充电周期
 *   0xDB+0x30: 设置VCOMH电压倍率
 *   0xA4: 全屏显示关闭 (正常模式, 非全亮)
 *   0xA6: 正常显示 (非反转)
 *   0x8D+0x14: 使能电荷泵 (内置DC-DC)
 *   0xAF: 打开显示
 */
void OLED_Init(void) {
    OLED_Command(0xAE);  /* 关闭显示 */
    OLED_Command(0xD5);  /* 设置显示时钟分频 */
    OLED_Command(0x80);
    OLED_Command(0xA8);  /* 设置多路复用比 */
    OLED_Command(0x3F);
    OLED_Command(0xD3);  /* 设置显示偏移 */
    OLED_Command(0x00);
    OLED_Command(0x40);  /* 设置起始行 */
    OLED_Command(0xA1);  /* 设置段重映射 (左右镜像) */
    OLED_Command(0xC8);  /* 设置COM扫描方向 (上下翻转) */
    OLED_Command(0xDA);  /* 设置COM硬件配置 */
    OLED_Command(0x12);
    OLED_Command(0x81);  /* 设置对比度 */
    OLED_Command(0xCF);
    OLED_Command(0xD9);  /* 设置预充电周期 */
    OLED_Command(0xF1);
    OLED_Command(0xDB);  /* 设置VCOMH电压 */
    OLED_Command(0x30);
    OLED_Command(0xA4);  /* 全屏显示关闭 (正常模式) */
    OLED_Command(0xA6);  /* 正常显示 (非反转) */
    OLED_Command(0x8D);  /* 使能电荷泵 */
    OLED_Command(0x14);
    OLED_Command(0xAF);  /* 打开显示 */
}

/* OLED_SetCursor — 设置光标位置 (后续数据从此位置开始写入)
 * x=0~127 (列地址), y=0~7 (页地址)
 * 列地址分两次设置: 低4位(0x00~0x0F) + 高4位(0x10~0x1F)
 */
void OLED_SetCursor(uint8_t x, uint8_t y) {
    OLED_Command(0x00 | (x & 0x0F));       /* 设置列地址低4位 */
    OLED_Command(0x10 | ((x & 0xF0) >> 4)); /* 设置列地址高4位 */
    OLED_Command(0xB0 | y);                 /* 设置页地址 */
}

/* OLED_Clear — 清屏: 将所有页所有列写入0x00 */
void OLED_Clear(void) {
    for (uint8_t page = 0; page < 8; page++) {
        OLED_SetCursor(0, page);
        for (uint8_t col = 0; col < 132; col++) {
            OLED_Data(0x00);               /* 写入0=灭 */
        }
    }
}

/* OLED_ShowChar — 在指定位置显示单个ASCII字符 (8x16)
 * 使用OLED_F8x16字体表, 索引 = ASCII码 - ' '
 * 上半部分(8字节)→当前页, 下半部分(8字节)→下一页
 */
void OLED_ShowChar(uint8_t x, uint8_t y, char data) {
    OLED_SetCursor(x, y);
    for (uint8_t i = 0; i < 8; i++) {
        OLED_Data(OLED_F8x16[data - ' '][i]);      /* 上半部分 */
    }
    OLED_SetCursor(x, y + 1);
    for (uint8_t i = 0; i < 8; i++) {
        OLED_Data(OLED_F8x16[data - ' '][i + 8]);  /* 下半部分 */
    }
}

/* OLED_ShowString — 在指定位置显示字符串 (每个字符8像素宽, 自动换列) */
void OLED_ShowString(uint8_t x, uint8_t y, char *data) {
    while (*data) {
        OLED_ShowChar(x, y, *data);
        x += 8;                              /* 每个字符宽8像素 */
        data++;
    }
}

/* OLED_ShowNum — 在指定位置显示单个数字 (0-9, 使用OLED_Numdata字体) */
void OLED_ShowNum(uint8_t x, uint8_t y, int num) {
    OLED_SetCursor(x, y);
    for (uint8_t i = 0; i < 8; i++) {
        OLED_Data(OLED_Numdata[num][i]);
    }
    OLED_SetCursor(x, y + 1);
    for (uint8_t i = 0; i < 8; i++) {
        OLED_Data(OLED_Numdata[num][i + 8]);
    }
}

/* OLED_ShowLongNum — 显示带符号的整数 (支持负数, 逐位显示) */
void OLED_ShowLongNum(uint8_t x, uint8_t y, int16_t num) {
    uint8_t digits[6];
    uint8_t len = 0;
    uint8_t is_negative = 0;

    if (num < 0) {
        is_negative = 1;
        num = -num;
    } else if (num == 0) {
        digits[len++] = 0;
    }

    while (num > 0) {
        digits[len++] = num % 10;            /* 提取个位 */
        num /= 10;
    }

    if (is_negative) {
        OLED_ShowChar(x, y, '-');
        x += 8;
    }

    for (int i = len - 1; i >= 0; i--) {    /* 从高位到低位显示 */
        OLED_ShowNum(x + (len - 1 - i) * 8, y, digits[i]);
    }
}

/* OLED_ShowImage — 在指定位置显示自定义图像
 * @param width  图像宽度(像素), 必须≤128
 * @param height 图像高度(页), 必须≤8
 * @param image  图像数据指针 (按页×宽排列)
 */
void OLED_ShowImage(uint8_t x, uint8_t y, uint8_t width, uint8_t height, uint8_t *image) {
    for (uint8_t page = 0; page < height; page++) {
        OLED_SetCursor(x, y + page);
        for (uint8_t col = 0; col < width; col++) {
            OLED_Data(image[page * width + col]);
        }
    }
}

/**
 * @brief  在OLED上显示指定位数的八进制数
 * @param  x      起始x坐标
 * @param  y      起始y坐标
 * @param  num    要显示的无符号整数
 * @param  digits 显示位数, 不足补0
 */
void OLED_ShowOctal(uint8_t x, uint8_t y, uint32_t num, uint8_t digits)
{
    char buf[12];
    buf[digits] = '\0';
    for (int i = digits - 1; i >= 0; i--) {
        buf[i] = '0' + (num & 0x7);          /* 取低3位 → 八进制数字 */
        num >>= 3;
    }
    OLED_ShowString(x, y, buf);
}

/**
 * @brief  在OLED上显示指定位数的16进制数
 * @param  x      起始x坐标
 * @param  y      起始y坐标
 * @param  num    要显示的无符号整数
 * @param  digits 显示位数, 不足补0
 */
void OLED_ShowHex(uint8_t x, uint8_t y, uint32_t num, uint8_t digits)
{
    char buf[12];
    buf[digits] = '\0';
    for (int i = digits - 1; i >= 0; i--) {
        uint8_t v = (num & 0xF);
        buf[i] = (v < 10) ? ('0' + v) : ('A' + v - 10);  /* 0-9→'0'-'9', 10-15→'A'-'F' */
        num >>= 4;
    }
    OLED_ShowString(x, y, buf);
}

/**
 * @brief  显示一个字节数组为16进制字符串
 * @param  x      起始x坐标
 * @param  y      起始y坐标
 * @param  data   数据指针
 * @param  len    数据长度
 */
void OLED_ShowHexArray(uint8_t x, uint8_t y, const uint8_t *data, uint8_t len)
{
    char buf[3];
    for (uint8_t i = 0; i < len; i++) {
        snprintf(buf, sizeof(buf), "%02X", data[i]);
        OLED_ShowString(x + i * 16, y, buf);  /* 每字节占16像素宽 ("XX "格式) */
    }
}

/**
 * @brief  显示一个字节数组为八进制字符串
 * @param  x      起始x坐标
 * @param  y      起始y坐标
 * @param  data   数据指针
 * @param  len    数据长度
 */
void OLED_ShowOctalArray(uint8_t x, uint8_t y, const uint8_t *data, uint8_t len)
{
    char buf[4];
    for (uint8_t i = 0; i < len; i++) {
        snprintf(buf, sizeof(buf), "%03o", data[i]);
        OLED_ShowString(x + i * 24, y, buf);  /* 每字节占24像素宽 */
    }
}
